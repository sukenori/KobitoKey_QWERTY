## config/west.yml
```yaml
manifest:
  remotes:
    - name: zmkfirmware
      url-base: https://github.com/zmkfirmware
    - name: badjeff
      url-base: https://github.com/badjeff
    - name: hsgw
      url-base: https://github.com/hsgw
    - name: caksoylar  # <-- led
      url-base: https://github.com/caksoylar
    - name: 46slv  # <-- 追加: 軸ロックスクロール
      url-base: https://github.com/46slv

  projects:
    - name: zmk
      remote: zmkfirmware
      revision: v0.3
      import: app/west.yml

    - name: zmk-pmw3610-driver
      remote: badjeff
      revision: zmk-0.3

    - name: zmk-feature-sensor_rotation
      remote: hsgw
      revision: main

    - name: zmk-rgbled-widget  # <-- led
      remote: caksoylar
      revision: v0.3

    - name: zmk-input-processor-roba-scroll  # <-- 追加
      remote: 46slv
      revision: main

  self:
    path: config
```
